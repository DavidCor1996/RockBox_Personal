## tools/ipod6g_android/linux-overlay/arch/arm/configs/apple_n25_eclair_native_defconfig
```kconfig
CONFIG_ARCH_S5L87XX=y
CONFIG_CPU_S5L8702=y
CONFIG_CPU_ARM926T=y
# CONFIG_ARCH_MULTI_V7 is not set
CONFIG_AEABI=y
CONFIG_ARM_THUMB=y
CONFIG_KUSER_HELPERS=y
CONFIG_MULTIUSER=y
CONFIG_FILE_LOCKING=y
CONFIG_COMPAT_32BIT_TIME=y
CONFIG_CMDLINE="console=ttySAC0,57600 earlycon=s5l,mmio32,0x3cc00000 rdinit=/init androidboot.hardware=n25 androidboot.console=ttySAC0 loglevel=8 panic=5"
CONFIG_CMDLINE_FORCE=y
CONFIG_EARLY_PRINTK=y
CONFIG_PRINTK_TIME=y
CONFIG_S5L8702_TIMER=y
CONFIG_SERIAL_SAMSUNG=y
CONFIG_SERIAL_SAMSUNG_CONSOLE=y
CONFIG_PHY_S5L8702_USB2=y
# CONFIG_USB is not set
CONFIG_USB_GADGET=y
CONFIG_USB_DWC2=y
CONFIG_USB_DWC2_PERIPHERAL=y
CONFIG_USB_G_SERIAL=y
CONFIG_TTY=y
CONFIG_DEVTMPFS=y
CONFIG_DEVTMPFS_MOUNT=y
CONFIG_UNIX98_PTYS=y
CONFIG_DEVPTS_FS=y
CONFIG_PROC_FS=y
CONFIG_SYSFS=y
CONFIG_TMPFS=y
CONFIG_TMPFS_XATTR=y
CONFIG_BLK_DEV_INITRD=y
CONFIG_BINFMT_ELF=y
# CONFIG_BINFMT_SCRIPT is not set
CONFIG_NET=y
CONFIG_UNIX=y
# CONFIG_INET is not set
# CONFIG_PACKET is not set
# CONFIG_NETDEVICES is not set
# CONFIG_ETHTOOL_NETLINK is not set
# CONFIG_NET_SCHED is not set
# CONFIG_NETFILTER is not set
# CONFIG_IPV6 is not set
# CONFIG_WIRELESS is not set
CONFIG_SYSVIPC=y
CONFIG_POSIX_MQUEUE=y
CONFIG_ANDROID_BINDER_IPC=y
CONFIG_ANDROID_BINDER_DEVICES="binder"
# CONFIG_ANDROID_BINDERFS is not set
# CONFIG_ANDROID_BINDER_IPC_SELFTEST is not set
# CONFIG_DEVMEM is not set
# CONFIG_IO_URING is not set
# CONFIG_BPF_SYSCALL is not set
CONFIG_INPUT=y
CONFIG_INPUT_EVDEV=y
# CONFIG_INPUT_MOUSEDEV is not set
# CONFIG_INPUT_JOYDEV is not set
CONFIG_INPUT_MISC=y
CONFIG_INPUT_S5L8702_N25_CLICKWHEEL=y
# CONFIG_INPUT_KEYBOARD is not set
# CONFIG_INPUT_MOUSE is not set
# CONFIG_INPUT_TOUCHSCREEN is not set
# CONFIG_SERIO is not set
# CONFIG_VT is not set
# CONFIG_HID is not set
# CONFIG_HW_RANDOM is not set
# CONFIG_MEDIA_SUPPORT is not set
# CONFIG_NETWORK_FILESYSTEMS is not set
CONFIG_EXPERT=y
CONFIG_EMBEDDED=y
CONFIG_CC_OPTIMIZE_FOR_SIZE=y
CONFIG_DEBUG_KERNEL=y
CONFIG_MAGIC_SYSRQ=y
CONFIG_PANIC_TIMEOUT=5
# CONFIG_MODULES is not set
# CONFIG_BLOCK is not set
# CONFIG_ATA is not set
# CONFIG_SCSI is not set
# CONFIG_MMC is not set
# CONFIG_MTD is not set
CONFIG_I2C=y
CONFIG_I2C_S5L8702=y
CONFIG_POWER_RESET=y
CONFIG_POWER_RESET_S5L8702=y
# CONFIG_SPI is not set
CONFIG_FB=y
CONFIG_FB_S5L8702=y
# CONFIG_FB_SIMPLE is not set
# CONFIG_SOUND is not set
# CONFIG_WLAN is not set
```

## tools/ipod6g_android/linux-overlay/arch/arm/configs/apple_n25_ramdiag_defconfig
```kconfig
CONFIG_ARCH_S5L87XX=y
CONFIG_CPU_S5L8702=y
CONFIG_CPU_ARM926T=y
CONFIG_S5L8702_N25_EARLY_LCD_BREADCRUMB=y
# CONFIG_ARCH_MULTI_V7 is not set
CONFIG_AEABI=y
CONFIG_CMDLINE="console=ttySAC0,57600 earlycon=s5l,mmio32,0x3cc00000 rdinit=/init loglevel=8 panic=5"
CONFIG_CMDLINE_FORCE=y
CONFIG_EARLY_PRINTK=y
CONFIG_PRINTK_TIME=y
CONFIG_S5L8702_TIMER=y
CONFIG_SERIAL_SAMSUNG=y
CONFIG_SERIAL_SAMSUNG_CONSOLE=y
CONFIG_PHY_S5L8702_USB2=y
# CONFIG_USB is not set
CONFIG_USB_GADGET=y
CONFIG_USB_DWC2=y
CONFIG_USB_DWC2_PERIPHERAL=y
CONFIG_USB_G_SERIAL=y
CONFIG_TTY=y
CONFIG_DEVTMPFS=y
CONFIG_DEVTMPFS_MOUNT=y
CONFIG_UNIX98_PTYS=y
CONFIG_DEVPTS_FS=y
CONFIG_TMPFS=y
CONFIG_BLK_DEV_INITRD=y
CONFIG_BINFMT_ELF=y
# CONFIG_BINFMT_SCRIPT is not set
# CONFIG_DEVMEM is not set
CONFIG_EXPERT=y
CONFIG_EMBEDDED=y
CONFIG_CC_OPTIMIZE_FOR_SIZE=y
CONFIG_DEBUG_KERNEL=y
CONFIG_MAGIC_SYSRQ=y
CONFIG_PANIC_TIMEOUT=5
CONFIG_POWER_RESET=y
CONFIG_POWER_RESET_S5L8702=y
# CONFIG_MODULES is not set
# CONFIG_BLOCK is not set
# CONFIG_ATA is not set
# CONFIG_SCSI is not set
# CONFIG_MMC is not set
# CONFIG_MTD is not set
# CONFIG_I2C is not set
# CONFIG_SPI is not set
CONFIG_FB=y
CONFIG_FB_S5L8702=y
# CONFIG_SOUND is not set
# CONFIG_WLAN is not set
```

## tools/ipod6g_android/linux-overlay/arch/arm/configs/eclair_qemu_arm926_defconfig
```kconfig
CONFIG_ARCH_MULTI_V5=y
CONFIG_MMU=y
CONFIG_ARM_PAN=y
CONFIG_ARCH_VERSATILE=y
CONFIG_CPU_ARM926T=y
CONFIG_AEABI=y
CONFIG_ARM_THUMB=y
CONFIG_KUSER_HELPERS=y
# CONFIG_OABI_COMPAT is not set
CONFIG_BINFMT_ELF=y
CONFIG_FUTEX=y
CONFIG_FILE_LOCKING=y
CONFIG_COMPAT_32BIT_TIME=y
CONFIG_EXPERT=y
CONFIG_EMBEDDED=y
CONFIG_MULTIUSER=y
CONFIG_BLK_DEV_INITRD=y
CONFIG_RD_GZIP=y
CONFIG_CMDLINE="console=ttyAMA0,115200 rdinit=/init androidboot.hardware=versatile androidboot.console=ttyAMA0 loglevel=6 panic=-1"
CONFIG_CMDLINE_FORCE=y
CONFIG_PRINTK=y
CONFIG_SERIAL_AMBA_PL011=y
CONFIG_SERIAL_AMBA_PL011_CONSOLE=y
CONFIG_TTY=y
CONFIG_UNIX98_PTYS=y
CONFIG_DEVPTS_FS=y
CONFIG_PROC_FS=y
CONFIG_SYSFS=y
CONFIG_SHMEM=y
CONFIG_TMPFS=y
CONFIG_TMPFS_XATTR=y
CONFIG_NET=y
CONFIG_UNIX=y
CONFIG_SYSVIPC=y
CONFIG_POSIX_MQUEUE=y
CONFIG_ANDROID_BINDER_IPC=y
CONFIG_ANDROID_BINDER_DEVICES="binder"
# CONFIG_ANDROID_BINDERFS is not set
# CONFIG_ANDROID_BINDER_IPC_SELFTEST is not set
# CONFIG_MODULES is not set
# CONFIG_BLOCK is not set
# CONFIG_INET is not set
# CONFIG_PACKET is not set
# CONFIG_NETDEVICES is not set
# CONFIG_INPUT is not set
# CONFIG_VT is not set
# CONFIG_I2C is not set
# CONFIG_SPI is not set
# CONFIG_DRM is not set
# CONFIG_FB is not set
# CONFIG_SOUND is not set
# CONFIG_MMC is not set
# CONFIG_MTD is not set
# CONFIG_SCSI is not set
# CONFIG_ATA is not set
# CONFIG_HID is not set
# CONFIG_MEDIA_SUPPORT is not set
# CONFIG_IO_URING is not set
# CONFIG_BPF_SYSCALL is not set
```

AudioEditor_GetReplacementSeq = 16777217;
BootCommands_Init = 16777221;
BossRush_InitSave = 16777225;
CVarClear = 16777229;
CVarGetColor = 16777233;
CVarGetColor24 = 16777237;
CVarGetFloat = 16777241;
CVarGetInteger = 16777245;
CVarGetString = 16777249;
CVarSave = 16777253;
CVarSetInteger = 16777257;
CVarSetString = 16777261;
Controller_ShouldRumble = 16777265;
CosmeticsEditor_GetDefaultValue = 16777269;
CrashHandlerRegisterCallback = 16777273;
CrashHandler_PrintSohData = 16777277;
Ctx_ReadSaveFile = 16777281;
Ctx_WriteSaveFile = 16777285;
DeinitOTR = 16777289;
Enhancement_GetNextNayrusItem = 16777293;
Enhancement_GetPrevNayrusItem = 16777297;
Entrance_GetOverride = 16777301;
Entrance_OverrideDynamicExit = 16777305;
Entrance_OverrideGerudoGuardCapture = 16777309;
Entrance_OverrideNextIndex = 16777313;
Entrance_SetEntranceDiscovered = 16777317;
FB_CopyToFramebuffer = 16777321;
FB_CreateFramebuffers = 16777325;
FB_DrawFromFramebuffer = 16777329;
FileChoose_DrawBossRushMenuWindowContents = 16777333;
FileChoose_UpdateBossRushMenu = 16777337;
GameConsole_Init = 16777341;
GameplayStats_GetCurrentTime = 16777345;
GetActorMaximumHealth = 16777349;
GetEquipNowMessage = 16777353;
GetFrequency = 16777357;
GetItemMystery = 16777361;
GetSeedIconIndex = 16777365;
GetSeedTexture = 16777369;
GetUnixTimestamp = 16777373;
GfxDebuggerDebugDisplayList = 16777377;
GfxDebuggerIsDebugging = 16777381;
GfxDebuggerIsDebuggingRequested = 16777385;
Gfx_RegisterBlendedTexture = 16777389;
Gfx_TextureCacheDelete = 16777393;
Gfx_UnregisterBlendedTexture = 16777397;
Graph_ProcessGfxCommands = 16777401;
Graph_StartFrame = 16777405;
Grotto_ForceGrottoReturn = 16777409;
Grotto_ForceRegularVoidOut = 16777413;
Grotto_GetRenamedGrottoIndexFromOriginal = 16777417;
Grotto_OverrideActorEntrance = 16777421;
Grotto_OverrideSpecialEntrance = 16777425;
InitOTR = 16777429;
Interface_ReplaceSpecialCharacters = 16777433;
ItemTable_Retrieve = 16777437;
ItemTable_RetrieveEntry = 16777441;
Mouse_HandleThirdPerson = 16777445;
Mouse_UpdateAll = 16777449;
NameTag_RemoveAllForActor = 16777453;
OTRControllerCallback = 16777457;
OTRGetAspectRatio = 16777461;
OTRGetDimensionFromLeftEdge = 16777465;
OTRGetDimensionFromRightEdge = 16777469;
OTRGetGameRenderHeight = 16777473;
OTRGetGameRenderWidth = 16777477;
OTRGetPixelDepth = 16777481;
OTRGetPixelDepthPrepare = 16777485;
OTRGetRectDimensionFromLeftEdge = 16777489;
OTRGetRectDimensionFromRightEdge = 16777493;
OTRGfxPrint = 16777497;
OTRMessage_Init = 16777501;
ObjectExtension_Free = 16777505;
ProcessSaveStateRequests = 16777509;
RandoKaleido_DrawMiscCollectibles = 16777513;
Randomizer_AdjustItemCategory = 16777517;
Randomizer_DrawTriforcePieceGI = 16777521;
Randomizer_GenerateRandomizer = 16777525;
Randomizer_GetCheckFromActor = 16777529;
Randomizer_GetItemFromKnownCheck = 16777533;
Randomizer_GetItemFromKnownCheckWithoutObtainabilityCheck = 16777537;
Randomizer_GetItemObtainabilityFromRandomizerCheck = 16777541;
Randomizer_GetNextAdultTradeItem = 16777545;
Randomizer_GetNextChildTradeItem = 16777549;
Randomizer_GetPrevAdultTradeItem = 16777553;
Randomizer_GetPrevChildTradeItem = 16777557;
Randomizer_GetSettingValue = 16777561;
Randomizer_IdentifyShopItem = 16777565;
Randomizer_InitSaveFile = 16777569;
Randomizer_IsCheckShuffled = 16777573;
Randomizer_IsGenerating = 16777577;
Randomizer_IsSeedGenerated = 16777581;
Randomizer_IsSpoilerLoaded = 16777585;
Randomizer_Item_Give = 16777589;
Randomizer_ParseSpoiler = 16777593;
Randomizer_SetSpoilerLoaded = 16777597;
Randomizer_ShowRandomizerMenu = 16777601;
Randomizer_WaitForGeneration = 16777605;
ResourceMgr_LoadJPEG = 16777609;
RetrieveGetItemIDFromItemID = 16777613;
RetrieveRandomizerGetFromItemID = 16777617;
SaveManager_ThreadPoolWait = 16777621;
Save_CopyFile = 16777625;
Save_DeleteFile = 16777629;
Save_GetSaveMetaInfo = 16777633;
Save_Init = 16777637;
Save_InitFile = 16777641;
Save_LoadFile = 16777645;
Save_SaveFile = 16777649;
Save_SaveGlobal = 16777653;
SetActorListIndex = 16777657;
SetAudioChannels = 16777661;
Ship_CreateQuadVertexGroup = 16777665;
Ship_GetActorSpawnObjectIndex = 16777669;
Ship_GetCharFontTexture = 16777673;
Ship_GetCharFontWidth = 16777677;
Ship_IsCStringEmpty = 16777681;
SohFileSelect_CountVisibleQuests = 16777685;
SohFileSelect_GetSettingText = 16777689;
SohFileSelect_IsQuestHidden = 16777693;
SohFileSelect_ShowPresetModal = 16777697;
SpoilerFileExists = 16777701;
WindowIsRunning = 16777705;
__assert_func = 16777709;
__osMaxControllers = 16777713;
__osMotorAccess = 16777717;
_sbrk = 16777721;
abort = 16777725;
acosf = 16777729;
calloc = 16777733;
disableBetaQuest = 16777737;
enableBetaQuest = 16777741;
exit = 16777745;
free = 16777749;
gBuildDate = 16777753;
gBuildMakeOption = 16777757;
gBuildTeam = 16777761;
gBuildVersionMajor = 16777765;
gBuildVersionMinor = 16777769;
gPauseFrameBuffer = 16777773;
gReusableFrameBuffer = 16777777;
gfx_create_framebuffer = 16777781;
gfx_texture_cache_clear = 16777785;
glActiveTexture = 16777789;
glAlphaFunc = 16777793;
glBindBuffer = 16777797;
glBindTexture = 16777801;
glBlendFunc = 16777805;
glBufferData = 16777809;
glClear = 16777813;
glClearColor = 16777817;
glClientActiveTexture = 16777821;
glColorPointer = 16777825;
glDeleteBuffers = 16777829;
glDeleteTextures = 16777833;
glDepthFunc = 16777837;
glDepthMask = 16777841;
glDisable = 16777845;
glDisableClientState = 16777849;
glDrawArrays = 16777853;
glEnable = 16777857;
glEnableClientState = 16777861;
glGenBuffers = 16777865;
glGenTextures = 16777869;
glGetError = 16777873;
glGetIntegerv = 16777877;
glLoadIdentity = 16777881;
glMatrixMode = 16777885;
glPixelStorei = 16777889;
glScissor = 16777893;
glTexCoordPointer = 16777897;
glTexEnvfv = 16777901;
glTexEnvi = 16777905;
glTexImage2D = 16777909;
glTexParameteri = 16777913;
glVertexPointer = 16777917;
glViewport = 16777921;
localtime = 16777925;
longjmp = 16777929;
lusprintf = 16777933;
malloc = 16777937;
memalign = 16777941;
memcmp = 16777945;
memmove = 16777949;
mktime = 16777953;
osCartRomInit = 16777957;
osContGetReadData = 16777961;
osContInit = 16777965;
osContStartReadData = 16777969;
osCreateViManager = 16777973;
osEPiStartDma = 16777977;
osGetCount = 16777981;
osGetTime = 16777985;
osMotorInit = 16777989;
osSetTimer = 16777993;
osViBlack = 16777997;
osViGetCurrentFramebuffer = 16778001;
osViGetNextFramebuffer = 16778005;
osViSetEvent = 16778009;
osViSetMode = 16778013;
osViSetSpecialFeatures = 16778017;
osViSetXScale = 16778021;
osViSetYScale = 16778025;
osViSwapBuffer = 16778029;
remove = 16778033;
setjmp = 16778037;
test_read_file = 16778041;
time = 16778045;
vsnprintf = 16778049;
SECTIONS {
 . = 0x10000;
 .text : { *(.text*) }
 .rodata : { *(.rodata*) }
 .data : { *(.data*) }
 .bss : { *(.bss*) *(COMMON) }
}

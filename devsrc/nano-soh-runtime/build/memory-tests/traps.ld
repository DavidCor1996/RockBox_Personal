AudioEditor_GetReplacementSeq = 16777217;
BootCommands_Init = 16777221;
BossRush_InitSave = 16777225;
CVarClear = 16777229;
CVarGetColor = 16777233;
CVarGetColor24 = 16777237;
CVarGetFloat = 16777241;
CVarGetInteger = 16777245;
CVarGetString = 16777249;
CVarSave = 16777253;
CVarSetInteger = 16777257;
CVarSetString = 16777261;
Controller_ShouldRumble = 16777265;
CosmeticsEditor_GetDefaultValue = 16777269;
CrashHandlerRegisterCallback = 16777273;
CrashHandler_PrintSohData = 16777277;
Ctx_ReadSaveFile = 16777281;
Ctx_WriteSaveFile = 16777285;
DeinitOTR = 16777289;
Enhancement_GetNextNayrusItem = 16777293;
Enhancement_GetPrevNayrusItem = 16777297;
Entrance_GetOverride = 16777301;
Entrance_OverrideDynamicExit = 16777305;
Entrance_OverrideGerudoGuardCapture = 16777309;
Entrance_OverrideNextIndex = 16777313;
Entrance_SetEntranceDiscovered = 16777317;
FB_CopyToFramebuffer = 16777321;
FB_CreateFramebuffers = 16777325;
FB_DrawFromFramebuffer = 16777329;
FileChoose_DrawBossRushMenuWindowContents = 16777333;
FileChoose_UpdateBossRushMenu = 16777337;
GameConsole_Init = 16777341;
GameplayStats_GetCurrentTime = 16777345;
GetActorMaximumHealth = 16777349;
GetEquipNowMessage = 16777353;
GetFrequency = 16777357;
GetItemMystery = 16777361;
GetSeedIconIndex = 16777365;
GetSeedTexture = 16777369;
GetUnixTimestamp = 16777373;
GfxDebuggerDebugDisplayList = 16777377;
GfxDebuggerIsDebugging = 16777381;
GfxDebuggerIsDebuggingRequested = 16777385;
Gfx_RegisterBlendedTexture = 16777389;
Gfx_TextureCacheDelete = 16777393;
Gfx_UnregisterBlendedTexture = 16777397;
Graph_ProcessGfxCommands = 16777401;
Graph_StartFrame = 16777405;
Grotto_ForceGrottoReturn = 16777409;
Grotto_ForceRegularVoidOut = 16777413;
Grotto_GetRenamedGrottoIndexFromOriginal = 16777417;
Grotto_OverrideActorEntrance = 16777421;
Grotto_OverrideSpecialEntrance = 16777425;
InitOTR = 16777429;
Interface_ReplaceSpecialCharacters = 16777433;
ItemTable_Retrieve = 16777437;
ItemTable_RetrieveEntry = 16777441;
Mouse_HandleThirdPerson = 16777445;
Mouse_UpdateAll = 16777449;
NameTag_RemoveAllForActor = 16777453;
OTRControllerCallback = 16777457;
OTRGetAspectRatio = 16777461;
OTRGetDimensionFromLeftEdge = 16777465;
OTRGetDimensionFromRightEdge = 16777469;
OTRGetGameRenderHeight = 16777473;
OTRGetGameRenderWidth = 16777477;
OTRGetPixelDepth = 16777481;
OTRGetPixelDepthPrepare = 16777485;
OTRGetRectDimensionFromLeftEdge = 16777489;
OTRGetRectDimensionFromRightEdge = 16777493;
OTRGfxPrint = 16777497;
OTRMessage_Init = 16777501;
ObjectExtension_Free = 16777505;
ProcessSaveStateRequests = 16777509;
RandoKaleido_DrawMiscCollectibles = 16777513;
Randomizer_AdjustItemCategory = 16777517;
Randomizer_DrawTriforcePieceGI = 16777521;
Randomizer_GenerateRandomizer = 16777525;
Randomizer_GetCheckFromActor = 16777529;
Randomizer_GetItemFromKnownCheck = 16777533;
Randomizer_GetItemFromKnownCheckWithoutObtainabilityCheck = 16777537;
Randomizer_GetItemObtainabilityFromRandomizerCheck = 16777541;
Randomizer_GetNextAdultTradeItem = 16777545;
Randomizer_GetNextChildTradeItem = 16777549;
Randomizer_GetPrevAdultTradeItem = 16777553;
Randomizer_GetPrevChildTradeItem = 16777557;
Randomizer_GetSettingValue = 16777561;
Randomizer_IdentifyShopItem = 16777565;
Randomizer_InitSaveFile = 16777569;
Randomizer_IsCheckShuffled = 16777573;
Randomizer_IsGenerating = 16777577;
Randomizer_IsSeedGenerated = 16777581;
Randomizer_IsSpoilerLoaded = 16777585;
Randomizer_Item_Give = 16777589;
Randomizer_ParseSpoiler = 16777593;
Randomizer_SetSpoilerLoaded = 16777597;
Randomizer_ShowRandomizerMenu = 16777601;
Randomizer_WaitForGeneration = 16777605;
ResourceMgr_LoadJPEG = 16777609;
RetrieveGetItemIDFromItemID = 16777613;
RetrieveRandomizerGetFromItemID = 16777617;
SaveManager_ThreadPoolWait = 16777621;
Save_CopyFile = 16777625;
Save_DeleteFile = 16777629;
Save_GetSaveMetaInfo = 16777633;
Save_Init = 16777637;
Save_InitFile = 16777641;
Save_LoadFile = 16777645;
Save_SaveFile = 16777649;
Save_SaveGlobal = 16777653;
SetActorListIndex = 16777657;
SetAudioChannels = 16777661;
Ship_CreateQuadVertexGroup = 16777665;
Ship_GetActorSpawnObjectIndex = 16777669;
Ship_GetCharFontTexture = 16777673;
Ship_GetCharFontWidth = 16777677;
Ship_IsCStringEmpty = 16777681;
SohFileSelect_CountVisibleQuests = 16777685;
SohFileSelect_GetSettingText = 16777689;
SohFileSelect_IsQuestHidden = 16777693;
SohFileSelect_ShowPresetModal = 16777697;
SpoilerFileExists = 16777701;
WindowIsRunning = 16777705;
__assert_func = 16777709;
__osMaxControllers = 16777713;
__osMotorAccess = 16777717;
abort = 16777721;
abs = 16777725;
acosf = 16777729;
atanf = 16777733;
calloc = 16777737;
ceilf = 16777741;
cosf = 16777745;
disableBetaQuest = 16777749;
enableBetaQuest = 16777753;
exit = 16777757;
fabsf = 16777761;
floorf = 16777765;
free = 16777769;
gBuildDate = 16777773;
gBuildMakeOption = 16777777;
gBuildTeam = 16777781;
gBuildVersionMajor = 16777785;
gBuildVersionMinor = 16777789;
gPauseFrameBuffer = 16777793;
gReusableFrameBuffer = 16777797;
gfx_create_framebuffer = 16777801;
gfx_texture_cache_clear = 16777805;
glActiveTexture = 16777809;
glAlphaFunc = 16777813;
glBindBuffer = 16777817;
glBindTexture = 16777821;
glBlendFunc = 16777825;
glBufferData = 16777829;
glClear = 16777833;
glClearColor = 16777837;
glClientActiveTexture = 16777841;
glColorPointer = 16777845;
glDeleteBuffers = 16777849;
glDeleteTextures = 16777853;
glDepthFunc = 16777857;
glDepthMask = 16777861;
glDisable = 16777865;
glDisableClientState = 16777869;
glDrawArrays = 16777873;
glEnable = 16777877;
glEnableClientState = 16777881;
glGenBuffers = 16777885;
glGenTextures = 16777889;
glGetError = 16777893;
glGetIntegerv = 16777897;
glLoadIdentity = 16777901;
glMatrixMode = 16777905;
glPixelStorei = 16777909;
glScissor = 16777913;
glTexCoordPointer = 16777917;
glTexEnvfv = 16777921;
glTexEnvi = 16777925;
glTexImage2D = 16777929;
glTexParameteri = 16777933;
glVertexPointer = 16777937;
glViewport = 16777941;
localtime = 16777945;
longjmp = 16777949;
lusprintf = 16777953;
malloc = 16777957;
memalign = 16777961;
memchr = 16777965;
memcmp = 16777969;
memmove = 16777973;
mktime = 16777977;
nearbyintf = 16777981;
osCartRomInit = 16777985;
osContGetReadData = 16777989;
osContInit = 16777993;
osContStartReadData = 16777997;
osCreateViManager = 16778001;
osEPiStartDma = 16778005;
osGetCount = 16778009;
osGetTime = 16778013;
osMotorInit = 16778017;
osSetTimer = 16778021;
osViBlack = 16778025;
osViGetCurrentFramebuffer = 16778029;
osViGetNextFramebuffer = 16778033;
osViSetEvent = 16778037;
osViSetMode = 16778041;
osViSetSpecialFeatures = 16778045;
osViSetXScale = 16778049;
osViSetYScale = 16778053;
osViSwapBuffer = 16778057;
remove = 16778061;
roundf = 16778065;
setjmp = 16778069;
sin = 16778073;
sinf = 16778077;
snprintf = 16778081;
sqrt = 16778085;
sqrtf = 16778089;
strcmp = 16778093;
strcpy = 16778097;
strlen = 16778101;
time = 16778105;
truncf = 16778109;
vsnprintf = 16778113;
SECTIONS {
 . = 0x10000;
 .text : { *(.text*) }
 .rodata : { *(.rodata*) }
 .data : { *(.data*) }
 .bss : { *(.bss*) *(COMMON) }
}
